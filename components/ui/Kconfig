## firmware/main/Kconfig.projbuild
```kconfig
menu "Nimbus"

    config NIMBUS_PREVIEW_READINGS
        bool "Show synthetic readings"
        default y
        help
            Cycles fixed IAQ, temperature, humidity and battery values every 4 s so
            each screen state can be checked on the device. There is no sensing or
            power component yet; turn this off once real readings are wired.

endmenu
```

## main/Kconfig.projbuild
```kconfig
menu "Nimbus diagnostics"
    config NIMBUS_BOARD_DIAGNOSTICS
        bool "Run stage 1 board diagnostics instead of the application"
        default n
        help
            UART-only bring-up: ADC_EN LOW/HIGH readings, RTC marker and manual
            deep-sleep. No UI, BSEC, battery percentage or automatic restart.
endmenu
```

## sdkconfig.defaults
```kconfig
CONFIG_IDF_TARGET="esp32"
CONFIG_ESPTOOLPY_FLASHSIZE_4MB=y
CONFIG_ESPTOOLPY_FLASHMODE_DIO=y
CONFIG_ESPTOOLPY_FLASHFREQ_80M=y

CONFIG_PARTITION_TABLE_CUSTOM=y
CONFIG_PARTITION_TABLE_CUSTOM_FILENAME="partitions.csv"

CONFIG_ESP_DEFAULT_CPU_FREQ_MHZ_160=y
CONFIG_PM_ENABLE=y
CONFIG_FREERTOS_USE_TICKLESS_IDLE=y
CONFIG_ESP_MAIN_TASK_STACK_SIZE=4096
CONFIG_LOG_DEFAULT_LEVEL_INFO=y

CONFIG_ESP_COREDUMP_ENABLE_TO_FLASH=y
CONFIG_ESP_COREDUMP_DATA_FORMAT_ELF=y
CONFIG_ESP_COREDUMP_CHECKSUM_CRC32=y
CONFIG_ESP_COREDUMP_MAX_TASKS_NUM=16
CONFIG_ESP_COREDUMP_STACK_SIZE=2048
# CONFIG_ESP_COREDUMP_CAPTURE_DRAM is not set

CONFIG_ESP_TASK_WDT_EN=y
CONFIG_ESP_TASK_WDT_INIT=y
CONFIG_ESP_TASK_WDT_PANIC=y
CONFIG_ESP_TASK_WDT_TIMEOUT_S=10
```
